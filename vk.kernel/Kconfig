## vk.kernel/Kconfig
```kconfig
comment "This is using to configure kernel"

config KERNEL
	bool "Enable building kernel"
	default y

if KERNEL

# config kernel menu

menu "kernel"

config TASK_STACK
	int "The size of thread task stack"
	default 1024

config MODULE
	bool "Enable loadable module support"
	select FATFS
	select ELFPARSER
	select ENVIRONMENT

config ENVIRONMENT
	depends on MODULE
	bool "Build the environment of Loadable module"
	default y

endmenu

#config subsystem

menu "subsys"

config SUBSYS
	depends on MODULE
	bool "Enable sub system support"
	default n

config LOADER
	depends on SUBSYS
	bool "Enable loader support"
	default y

config INPUT
	depends on SUBSYS
	bool "Enable input support"
	default y

config WORKQUEUE
	depends on SUBSYS
	bool "Enable workqueue support"
	default y

endmenu

# config file system

menu "filesys"

config FILESYSTEM
	bool "Enable file system"
	default n

config FATFS
	depends on FILESYSTEM
	bool "Add fat file system in support list"
	default n

endmenu

# confg utilities menu

menu "utilities"

menu "fileutils"

comment "This is using to configure fileutils"

config FILEUTILS
	select FILESYSTEM
	bool "Enable file utils support"
	default n

config DIRSTREAM
	depends on FILEUTILS
	bool "Enable dirstream function"
	default n

config DRVSTREAM
	depends on FILEUTILS
	bool "Enable drvstream function"
	default n

config FILESTREAM
	depends on FILEUTILS
	bool "Enable filestream function"
	default n

config FILESYSOPT
	depends on FILEUTILS
	bool "Enable filesysopt function"
	default n

endmenu

menu "binutils"

comment "This is using to configure binutils"

config BINUTILS
	select FILESTREAM
	bool "Enable binutils function"
	default n

config BINLOADER
	depends on BINUTILS
	select FILESTREAM
	bool "Enable *.bin file load function"
	default n

config BINEXECUTOR
	depends on BINUTILS
	select BINLOADER
	bool "Enable execute *.bin file function"
	default n

config ELFLOADER
	depends on BINUTILS
	select FILESTREAM
	bool "Enable *.elf file load function"
	default n

config ELFEXECUTOR
	depends on BINUTILS
	select ELFLOADER
	bool "Enable execute *.elf file function"
	default n

config LIBTOOL
	depends on BINUTILS
	bool "Enable library tool function"
	default n

config MODTOOL
	depends on BINUTILS
	bool "Enable module tool function"
	default n

endmenu

menu "parser"

comment "This is using to configure parser"

config PARSER
	bool "Enable parser support"
	default n

config INIPARSER
	depends on PARSER
	select FILESTREAM
	bool "Enable ini file parser function"
	default n

config PINPARSER
	depends on PARSER
	select FATFS
	bool "Enable pin parser function"
	default n

config RCPARSER
	depends on PARSER
	select FILESTREAM
	bool "Enable resource script parser function"
	default n

config REGEX
	depends on PARSER
	bool "Enable regex function"
	default n

endmenu

menu "sync"

comment "This is using to configure sync"

config SYNC
	bool "Enable synchronizes function"
	default y

config MUTEX
	depends on SYNC
	bool "Enable mutex lock support"
	default y

config SPINLOCK
	depends on SYNC
	bool "Enable spin lock support"
	default y

config SEMAPHORE
	depends on SYNC
	bool "Enable semaphore support"
	default y

endmenu

endmenu

endif
```
